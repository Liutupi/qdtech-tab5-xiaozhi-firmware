## updater/sdkconfig.defaults
```kconfig
CONFIG_IDF_TARGET="esp32p4"
CONFIG_ESPTOOLPY_FLASHSIZE_16MB=y
CONFIG_ESPTOOLPY_FLASHMODE_QIO=y
CONFIG_ESPTOOLPY_FLASHFREQ_80M=y
CONFIG_PARTITION_TABLE_CUSTOM=y
CONFIG_PARTITION_TABLE_CUSTOM_FILENAME="../partitions/qdtech_tab5.csv"
CONFIG_PARTITION_TABLE_FILENAME="../partitions/qdtech_tab5.csv"
CONFIG_PARTITION_TABLE_OFFSET=0x8000
CONFIG_ESP32P4_SELECTS_REV_LESS_V3=y
CONFIG_ESP32P4_REV_MIN_100=y
CONFIG_ESP_DEFAULT_CPU_FREQ_MHZ_360=y
CONFIG_COMPILER_OPTIMIZATION_SIZE=y
CONFIG_BOOTLOADER_APP_ROLLBACK_ENABLE=y
CONFIG_ESP_CONSOLE_UART_DEFAULT=y
CONFIG_ESP_CONSOLE_SECONDARY_USB_SERIAL_JTAG=y
CONFIG_ESP_MAIN_TASK_STACK_SIZE=8192
# Flash erase/write of ~10 MB must not trip the watchdog.
CONFIG_ESP_TASK_WDT_INIT=n
```

## vendor_overrides/78__esp-ml307/Kconfig
```kconfig
menu "ESP network transport"

config ESP_ML307_SSL_RX_STACK_IN_PSRAM
    bool "Allocate TLS receive task stacks in PSRAM"
    depends on SPIRAM && FREERTOS_TASK_CREATE_ALLOW_EXT_MEM
    default n
    help
        Keep TLS receive stacks out of fragmented internal RAM. The task control
        block remains in internal RAM. Enable only when receive callbacks are
        safe to run from an external stack: flash writes must run in another task.
        The connection owner reclaims each stack when disconnecting.

endmenu
```
